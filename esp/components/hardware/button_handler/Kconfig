## esp/components/hardware/button_handler/Kconfig
```kconfig
menu "Button Handler Configuration"

    config DEBOUNCE_TIME_MS
        int "DEBOUNCE TIME (ms)"
        range 0 1000
        default 50

    config BUTTON_DEVICE
        int "BUTTON DEVICE"
        range 0 48
        default 32

    config BUTTON_INTERVAL
        int "BUTTON INTERVAL"
        range 0 48
        default 33

    config BUTTON_LIGHT
        int "BUTTON LIGHT"
        range 0 48
        default 25

    config BUTTON_FAN
        int "BUTTON FAN"
        range 0 48
        default 26

endmenu
```

## esp/components/hardware/device_control/Kconfig
```kconfig
menu "Device Control Configuration"

    config DEVICE_ACTIVE_LEVEL
        int "Device Active Level"
        range 0 1
        default 1
        help
            0 = Active LOW (device ON when GPIO is LOW)
            1 = Active HIGH (device ON when GPIO is HIGH)

    config DEVICE_FAN_PIN
        int "Fan Control GPIO"
        range 0 48
        default 16
        help
            GPIO pin number for controlling the fan device.

    config DEVICE_LIGHT_PIN
        int "Light Control GPIO"
        range 0 48
        default 17
        help
            GPIO pin number for controlling the light device.

endmenu
```

## esp/esp/components/communication/wifi_manager/Kconfig
```kconfig
menu "WiFi Manager Configuration"

    config WIFI_AP_SSID
        string "SoftAP SSID for provisioning"
        default "SmartHome_Setup"
        help
            SSID for the SoftAP mode during WiFi provisioning

    config WIFI_MAX_RETRY
        int "Maximum WiFi reconnection attempts"
        range 1 10
        default 5
        help
            Number of reconnection attempts before giving up

    config SCAN_MAX_AP
        int "Maximum number of APs to scan"
        range 5 50
        default 10
        help
            Maximum number of Access Points to return during WiFi scan

    config HTTP_SERVER_PORT
        int "HTTP Server Port"
        range 1 65535
        default 80
        help
            Port number for the HTTP server used in WiFi provisioning

    config DNS_SERVER_PORT
        int "DNS Server Port"
        range 1 65535
        default 53
        help
            Port number for the DNS server used in captive portal

endmenu
```

## esp/esp/components/hardware/button_handler/Kconfig
```kconfig
menu "Button Handler Configuration"

    config BUTTON_MODE
        int "BUTTON MODE GPIO"
        range 0 48
        default 32
        help
            Set the GPIO number for the mode button.

    config BUTTON_WIFI
        int "BUTTON WIFI GPIO"
        range 0 48
        default 33
        help
            Set the GPIO number for the interval button.

    config BUTTON_LIGHT
        int "BUTTON LIGHT GPIO"
        range 0 48
        default 25
        help
            Set the GPIO number for the light button.

    config BUTTON_FAN
        int "BUTTON FAN GPIO"
        range 0 48
        default 26
        help
            Set the GPIO number for the fan button.

    config BUTTON_AC
        int "BUTTON AC GPIO"
        range 0 48
        default 23
        help
            Set the GPIO number for the AC button.

    config BUTTON_POLL_INTERVAL_MS
        int "BUTTON POLL INTERVAL (ms)"
        range 1 1000
        default 10
    
    config DEBOUNCE_TIME_MS
        int "DEBOUNCE TIME (ms)"
        range 0 1000
        default 50
        help
            Set the debounce time for button presses in milliseconds.

endmenu
```

## esp/esp_demo/main/Kconfig.projbuild
```kconfig
menu "SMART HOME DEVICE CONFIGURATION"
    
    rsource "../components/application/task_manager/Kconfig"

    menu "Communication Layer Configuration"
    
    # WiFi Manager Configuration
    rsource "../components/communication/wifi_manager/Kconfig"

    # MQTT Manager Configuration
    rsource "../components/communication/mqtt_manager/Kconfig"

    endmenu

    # Hardware Layer Configuration
    menu "Hardware Layer Configuration"

        # Button Handler Configuration
        rsource "../components/hardware/button_handler/Kconfig"

        # Device Control Configuration
        rsource "../components/hardware/device_control/Kconfig"

        # Status LED Configuration
        rsource "../components/hardware/status_led/Kconfig"

    endmenu

    menu "Hardware Protocol Configuration"

        # I2C Interface Configuration
        rsource "../components/sensor/i2cdev/Kconfig"

    endmenu

endmenu
```

## esp/esp_no_tls/components/communication/mqtt_manager/Kconfig
```kconfig
menu "MQTT Manager Configuration"

    config MQTT_BASE_TOPIC
        string "Base Topic"
        default "SmartHome"
        help
            Base topic for all MQTT messages.
            Topics will be: {base}/...

    config MQTT_DEVICE_ID
        string "Device ID"
        default "esp_01"
        help
            Topics will be: {base}/{device_id}/...

    config MQTT_BROKER_URI
        string "MQTT Broker URI"
        default "raspberrypi.local"
        help
            URI of the MQTT broker to connect to.

    config MQTT_BROKER_PORT
        int "MQTT Broker Port"
        default 1883
        help
            Port number for the MQTT broker connection (1883 for non-TLS, 8883 for TLS).

    config MQTT_USERNAME
        string "MQTT Username"
        default ""
        help
            MQTT broker username (leave empty if not required)

    config MQTT_PASSWORD
        string "MQTT Password"
        default ""
        help
            MQTT broker password (leave empty if not required)

    config MQTT_KEEP_ALIVE_SEC
        int "MQTT Keep Alive (seconds)"
        default 120
        help
            Keep alive interval in seconds for MQTT connection.

endmenu
```

## esp/esp_no_tls/components/sensor/i2cdev/Kconfig
```kconfig
menu "I2C Device Configuration"

    config I2C_MASTER_SDA_PIN
        int "I2C Master SDA GPIO"
        range 0 48
        default 21
        help
            GPIO pin number for I2C SDA (data line).

    config I2C_MASTER_SCL_PIN
        int "I2C Master SCL GPIO"
        range 0 48
        default 22
        help
            GPIO pin number for I2C SCL (clock line).

    config I2C_MASTER_FREQ_HZ
        int "I2C Master Clock Frequency (Hz)"
        default 100000
        help
            I2C master clock frequency in Hz.
            Common values: 100000 (standard mode), 400000 (fast mode).

    config I2C_MASTER_PORT
        int "I2C Master Port Number"
        range 0 1
        default 0
        help
            I2C port number (0 or 1).

    config I2CDEV_TIMEOUT_MS
        int "I2C Transaction Timeout (ms)"
        default 1000
        help
            Timeout for I2C transactions in milliseconds.

    config I2CDEV_DEBUG
        bool "Enable I2C Debug Logging"
        default n
        help
            Enable detailed debug logging for I2C transactions.

endmenu
```

## esp/esp_no_tls_demo/components/application/task_manager/Kconfig
```kconfig
menu "APPLICATION MANAGER "

    config VERSION_APP
        string "Application Version"
        default "1.0"
        help
            Version of the application layer.

    config INTERVAL_TIME_MS
        int "Interval Time (ms)"
        default 5000
        help
            Time interval in milliseconds for periodic tasks.

endmenu
```

## esp_demo/components/communication/mqtt_manager/Kconfig
```kconfig
menu "MQTT Manager Configuration"

    config MQTT_BASE_TOPIC
        string "Base Topic"
        default "SmartHome"
        help
            Base topic for all MQTT messages.
            Topics will be: {base}/...

    config MQTT_DEVICE_ID
        string "Device ID"
        default "esp_01"
        help
            Topics will be: {base}/{device_id}/...

    config MQTT_BROKER_URI
        string "MQTT Broker URI"
        default "6ceea111b6144c71a57b21faa3553fc6.s1.eu.hivemq.cloud"
        help
            URI of the MQTT broker to connect to.

    config MQTT_BROKER_PORT
        int "MQTT Broker Port"
        default 8883
        help
            Port number for the MQTT broker connection.

    config MQTT_USERNAME
        string "MQTT Username"
        default ""
        help
            MQTT broker username (leave empty if not required)

    config MQTT_PASSWORD
        string "MQTT Password"
        default ""
        help
            MQTT broker password (leave empty if not required)

    config MQTT_KEEP_ALIVE_SEC
        int "MQTT Keep Alive (seconds)"
        default 120
        help
            Keep alive interval in seconds for MQTT connection.

endmenu
```

## esp_demo/components/hardware/status_led/Kconfig
```kconfig
menu "Status LED Configuration"

    config LED_ACTIVE_LEVEL
        int "LED Active Level"
        range 0 1
        default 1
        help
            0 = Active LOW (LED ON when GPIO is LOW)
            1 = Active HIGH (LED ON when GPIO is HIGH)    

    config LED_GPIO_DEVICE
        int "LED DEVICE GPIO"
        range 0 48
        default 27
        help
            GPIO number for device status LED

    config LED_GPIO_WIFI
        int "LED WIFI GPIO"
        range 0 48
        default 14
        help
            GPIO number for WiFi status LED

    config LED_GPIO_MQTT
        int "LED MQTT GPIO"
        range 0 48
        default 13
        help
            GPIO number for MQTT status LED

endmenu
```
